## src/modules/mc_indi_rate_control/Kconfig
```kconfig
menuconfig MODULES_MC_INDI_RATE_CONTROL
	bool "mc_indi_rate_control"
	default n
	depends on MODULES_CONTROL_ALLOCATOR
	---help---
		Enable support for mc_indi_rate_control, the INDI alternative to mc_rate_control.
		Needs the effectiveness library of the control allocator for the rotor geometry.
```
