## src/modules/mc_indi_pos_control/Kconfig
```kconfig
menuconfig MODULES_MC_INDI_POS_CONTROL
	bool "mc_indi_pos_control"
	default n
	depends on MODULES_MC_POS_CONTROL
	---help---
		Enable mc_indi_pos_control, started instead of mc_pos_control when MC_INDI_POS_EN is 1:
		stock position control followed by an acceleration INDI stage.
```

## src/modules/simulation/sim_scenario_player/Kconfig
```kconfig
menuconfig MODULES_SIMULATION_SIM_SCENARIO_PLAYER
	bool "sim_scenario_player"
	default n
	---help---
		SITL only. Plays a scenario schedule file (arm, mode, offboard setpoints) in simulation time
		on uORB, in place of the MAVLink messages of an external runner.
```
